// This program controls a treaded robot 
// The user has the ability to make the robot go forwards, backwards, and stop
// The user can also control the speed of the robot

int state;          // Variable for Bluetooth Input
int enA = 11;       // Right Motor enabled on pin 11
int in1 = 12;
int in2 = 13;
int enB = 6;        // Left Motor enabled on pin 6
int in3 = 7;
int in4 = 8;
int speed = 255;          // Integer to keep track of motor's speed
boolean on = false; // Boolean for if the motor is on or off

void setup() {
  Serial.begin(9600);    // Begins Bluetooth Communication

  //Setting selected pins to output mode
  pinMode(enA, OUTPUT);  // Right Motor
  pinMode(in1, OUTPUT);
  pinMode(in2, OUTPUT);
  pinMode(enB, OUTPUT);  // Left Motor
  pinMode(in3, OUTPUT);
  pinMode(in4, OUTPUT);

  // Set initial rotation direction
  digitalWrite(in1, LOW); // Right Motor
  digitalWrite(in2, HIGH);
  digitalWrite(in3, LOW); // Left Motor
  digitalWrite(in4, HIGH);

  // Set inital power of motor to 0. Can be any value from 0 (OFF) - 255 (FULL POWER).
  analogWrite(enA, 0);   // Right Motor
  analogWrite(enB, 0);   // Left Motor
}

void loop() {
  if (Serial.available() > 0) { // Check for a connection to the Bluetooth module
    state = Serial.read();      // Read data sent to the Bluetooth module
  }
  // Stops robot
  if (state == 'S') {
    motorOff();
    Serial.print("stop");
  }
  // Moves robot backwards
  if (state == 'B') {
    motorOff();
    voltBack();
    motorOn(speed);
    Serial.print("back");
  }

  // Moves Robot forward
  if (state == 'F') {
    motorOff();
    voltFor();
    motorOn(speed);
    Serial.print("forward");
  }
  
  //Sets the speed to medium
  if (state == 'm') {
    speed = 175;
    if(on) {
      motorOn(speed);
    }
  }
  
  //Sets the speed to fast
  if (state == 'f') {
    speed = 255;
    if(on) {
      motorOn(speed);
    }
  }
  
  //Sets the speed to sl
  if (state == 's') {
    speed = 100;
    if(on) {
      motorOn(speed);
    }
  }
}

// This method changes the polarity of the voltage, making the motors move forward
void voltFor() {
  digitalWrite(in1, HIGH);
  digitalWrite(in2, LOW);
  digitalWrite(in3, HIGH);
  digitalWrite(in4, LOW);
}

// This method changes the polarity of the voltage, making the motors move backwards
void voltBack() {
  digitalWrite(in1, LOW);
  digitalWrite(in2, HIGH);
  digitalWrite(in3, LOW);
  digitalWrite(in4, HIGH);
}

// This method turns the motors on to a user inputted speed(1 - 255)
void motorOn(int speed) {
  on = true;
  analogWrite(enA, speed);
  analogWrite(enB, speed);
}

// This method turns the motors off 
void motorOff() {
  on = false;
  analogWrite(enB, 0);
  analogWrite(enA, 0);
}